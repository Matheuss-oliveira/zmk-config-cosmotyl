#include "cosmos.dtsi"

&kscan0 {
    compatible = "zmk,kscan-gpio-matrix";
    col-gpios = <&gpio0 31 GPIO_ACTIVE_HIGH>
                , <&gpio0 29 GPIO_ACTIVE_HIGH>
                , <&gpio0 2 GPIO_ACTIVE_HIGH>
                , <&gpio1 15 GPIO_ACTIVE_HIGH>
                , <&gpio1 13 GPIO_ACTIVE_HIGH>
                , <&gpio1 11 GPIO_ACTIVE_HIGH>;

    row-gpios = <&gpio0 22 (GPIO_ACTIVE_HIGH | GPIO_PULL_DOWN)>
            , <&gpio0 24 (GPIO_ACTIVE_HIGH | GPIO_PULL_DOWN)> 
            , <&gpio1 0 (GPIO_ACTIVE_HIGH | GPIO_PULL_DOWN)>
            , <&gpio0 11 (GPIO_ACTIVE_HIGH | GPIO_PULL_DOWN)>
            , <&gpio1 4 (GPIO_ACTIVE_HIGH | GPIO_PULL_DOWN)>
            ;
};